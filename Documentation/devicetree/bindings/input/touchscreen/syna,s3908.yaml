## Documentation/devicetree/bindings/input/touchscreen/syna,s3908.yaml
```yaml
# SPDX-License-Identifier: (GPL-2.0-only OR BSD-2-Clause)
%YAML 1.2
---
$id: http://devicetree.org/schemas/input/touchscreen/syna,s3908.yaml#
$schema: http://devicetree.org/meta-schemas/core.yaml#

title: Synaptics TCM Oncell S3908 I2C touchscreen

maintainers:
  - Casey Connolly <kcxt@postmarketos.org>

allOf:
  - $ref: touchscreen.yaml#

properties:
  compatible:
    enum:
      - syna,s3908

  reg:
    maxItems: 1

  interrupts:
    maxItems: 1

  reset-gpios:
    maxItems: 1
    description: Reset GPIO the chip is connected to.

  vdd-supply:
    description: a phandle for the regulator supplying 3V power.

  vcc-supply:
    description: a phandle for the regulator supplying IO power.

required:
  - compatible
  - reg
  - interrupts
  - reset-gpios
  - vdd-supply
  - vcc-supply

additionalProperties: false

examples:
  - |
    #include <dt-bindings/interrupt-controller/irq.h>
    #include <dt-bindings/gpio/gpio.h>

    i2c {
      #address-cells = <1>;
      #size-cells = <0>;

      touchscreen@4b {
        compatible = "syna,s3908";
        reg = <0x4B>;

        interrupts-extended = <&tlmm 39 IRQ_TYPE_LEVEL_LOW>;

        reset-gpios = <&tlmm 38 GPIO_ACTIVE_LOW>;

        vdd-supply = <&vreg_l13a_ts_3p0>;
        vcc-supply = <&vreg_l1c_1p8>;
      };
    };
```

## Documentation/devicetree/bindings/sound/nxp,tfa987x.yaml
```yaml
# SPDX-License-Identifier: (GPL-2.0-only OR BSD-2-Clause)
%YAML 1.2
---
$id: http://devicetree.org/schemas/sound/nxp,tfa987x.yaml#
$schema: http://devicetree.org/meta-schemas/core.yaml#

title: NXP/Goodix TFA987X (TFA1) Audio Amplifiers

maintainers:
  - Stephan Gerhold <stephan@gerhold.net>

allOf:
  - $ref: dai-common.yaml#

properties:
  compatible:
    enum:
      - nxp,tfa9872
      - nxp,tfa9873
      - nxp,tfa9874

  reg:
    maxItems: 1

  '#sound-dai-cells':
    const: 0

  reset-gpios:
    description: optional reset GPIO.

  sound-name-prefix: true

  vddd-supply:
    description: regulator phandle for the VDDD power supply.

required:
  - compatible
  - reg
  - '#sound-dai-cells'

additionalProperties: false

examples:
  - |
    i2c {
      #address-cells = <1>;
      #size-cells = <0>;

      audio-codec@34 {
        compatible = "nxp,tfa9872";
        reg = <0x34>;
        sound-name-prefix = "Speaker Left";
        #sound-dai-cells = <0>;
      };
      audio-codec@36 {
        compatible = "nxp,tfa9872";
        reg = <0x36>;
        sound-name-prefix = "Speaker Right";
        #sound-dai-cells = <0>;
      };
    };

  - |
    #include <dt-bindings/gpio/gpio.h>
    i2c {
      #address-cells = <1>;
      #size-cells = <0>;

      top_spkr: audio-codec@34 {
        compatible = "nxp,tfa9874";
        reg = <0x34>;
        reset-gpios = <&tlmm 91 GPIO_ACTIVE_HIGH>;
        vddd-supply = <&vreg_s4a_1p8>;
        sound-channel = <0>;
        sound-name-prefix = "Top Speaker";
        #sound-dai-cells = <0>;
      };

      bottom_spkr: audio-codec@35 {
        compatible = "nxp,tfa9874";
        reg = <0x35>;
        reset-gpios = <&tlmm 99 GPIO_ACTIVE_HIGH>;
        vddd-supply = <&vreg_s4a_1p8>;
        sound-channel = <1>;
        sound-name-prefix = "Bottom Speaker";
        #sound-dai-cells = <0>;
      };
    };
```

## drivers/bus/mhi/host/Kconfig
```kconfig
# SPDX-License-Identifier: GPL-2.0
#
# MHI bus
#
# Copyright (c) 2018-2020, The Linux Foundation. All rights reserved.
#

config MHI_BUS
	tristate "Modem Host Interface (MHI) bus"
	help
	  Bus driver for MHI protocol. Modem Host Interface (MHI) is a
	  communication protocol used by the host processors to control
	  and communicate with modem devices over a high speed peripheral
	  bus or shared memory.

config MHI_BUS_DEBUG
	bool "Debugfs support for the MHI bus"
	depends on MHI_BUS && DEBUG_FS
	help
	  Enable debugfs support for use with the MHI transport. Allows
	  reading and/or modifying some values within the MHI controller
	  for debug and test purposes.

config MHI_BUS_PCI_GENERIC
	tristate "MHI PCI controller driver"
	depends on MHI_BUS
	depends on PCI
	help
	  This driver provides MHI PCI controller driver for devices such as
	  Qualcomm SDX55 based PCIe modems.


config MHI_BUS_SAHARA_MDM
	tristate "Sahara image loader for flashless MHI modems"
	depends on MHI_BUS
	depends on BLOCK
	select WANT_DEV_COREDUMP
	help
	  Serves boot images over the MHI SAHARA channel to flashless
	  external modems such as the SDX55 on the OnePlus 8T, after the MHI
	  core has pushed SBL over BHI. Images come from the firmware loader
	  or from raw EFS/DDR partitions.
```

## drivers/input/fingerprint/Kconfig
```kconfig
# SPDX-License-Identifier: GPL-2.0-only
config FINGERPRINT_GOODIX_FP
	tristate "Goodix TEE fingerprint sensor control (/dev/goodix_fp)"
	help
	  Power, reset and interrupt control for Goodix fingerprint sensors whose
	  data path runs in the Qualcomm TEE, as on the Nothing Phone (2).
```

## drivers/input/misc/oplus_tri_state_key/Kconfig
```kconfig
# SPDX-License-Identifier: GPL-2.0-only
config INPUT_OPLUS_TRI_STATE_KEY
	tristate "OPlus dual-Hall Alert Slider (tri-state key) support"
	depends on I2C && INPUT
	help
	  Say Y here to enable support for the 3-position magnetic Alert Slider
	  used on OnePlus SM8250 devices (OnePlus 8 / 8 Pro / 8T) backed by
	  dual iSentek IST8801 or MagnaChip MXM1120 Hall-effect sensors.

	  To compile this driver as a module, choose M here: the module will
	  be called oplus-tri-state-key.
```
